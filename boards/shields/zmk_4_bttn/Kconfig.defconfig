## boards/shields/zmk_4_bttn/Kconfig.defconfig
```kconfig
# Copyright (c) 2022 The ZMK Contributors
# SPDX-License-Identifier: MIT

if SHIELD_ZMK_4_BTTN

config ZMK_KEYBOARD_NAME
    default "zmk_4_bttn"

endif
```

## boards/shields/zmk_4_bttn/Kconfig.shield
```kconfig
# Copyright (c) 2022 The ZMK Contributors
# SPDX-License-Identifier: MIT

config SHIELD_ZMK_4_BTTN
    def_bool $(shields_list_contains,zmk_4_bttn)
```
